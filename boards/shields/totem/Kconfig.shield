## boards/shields/totem/Kconfig.shield
```kconfig
config SHIELD_TOTEM_LEFT
    def_bool $(shields_list_contains,totem_left)

config SHIELD_TOTEM_RIGHT
    def_bool $(shields_list_contains,totem_right)

config SHIELD_TOTEM_LEFT_W_DONGLE
    def_bool $(shields_list_contains,totem_left_w_dongle)

config SHIELD_TOTEM_DONGLE
    def_bool $(shields_list_contains,totem_dongle)
```
