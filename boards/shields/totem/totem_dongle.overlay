#include "totem.dtsi"

/ {
    chosen {
        zmk,kscan = &mock_kscan;
    };

    /delete-node/ seed_xiao_kscan;

    mock_kscan: kscan_1 {
        compatible = "zmk,kscan-mock";
        columns = <0>;
        rows = <0>;
        events = <0>;
    };
};
