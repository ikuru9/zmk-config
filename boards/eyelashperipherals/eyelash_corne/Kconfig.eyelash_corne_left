## boards/eyelashperipherals/eyelash_corne/Kconfig.eyelash_corne_left
```kconfig
#
# Copyright (c) 2024 The ZMK Contributors
#

config BOARD_EYELASH_CORNE_LEFT
    select SOC_NRF52840_QIAA
    select ZMK_BOARD_COMPAT
```

## boards/eyelashperipherals/eyelash_corne/board.yml
```yaml
boards:
  - name: eyelash_corne_left
    full_name: Eyelash Corne Left
    vendor: eyelashperipherals
    socs:
      - name: nrf52840
        variants:
          - name: zmk
  - name: eyelash_corne_right
    full_name: Eyelash Corne Right
    vendor: eyelashperipherals
    socs:
      - name: nrf52840
        variants:
          - name: zmk
```

## config/west.yml
```yaml
manifest:
  defaults:
    revision: main
  remotes:
    - name: zmkfirmware
      url-base: https://github.com/zmkfirmware
    # Additional modules containing boards/shields/custom code can be listed here as well
    # See https://docs.zephyrproject.org/3.2.0/develop/west/manifest.html#projects
    - name: urob
      url-base: https://github.com/urob

    - name: englmaxi
      url-base: https://github.com/englmaxi
    - name: carrefinho
      url-base: https://github.com/carrefinho

    - name: zzeneg
      url-base: https://github.com/zzeneg
    - name: srwi
      url-base: https://github.com/srwi
  projects:
    - name: zmk
      remote: zmkfirmware
      import: app/west.yml

    ## Urob's ZMK modules
    - name: zmk-adaptive-key
      path: modules/zmk/adaptive-key
      remote: urob
    - name: zmk-auto-layer
      path: modules/zmk/auto-layer
      remote: urob
    - name: zmk-tri-state
      path: modules/zmk/tri-state
      remote: urob

    ## ZMK Dongle Display
    - name: zmk-dongle-display
      remote: englmaxi

    ## Prospector Dongle
    - name: prospector-zmk-module
      remote: carrefinho
      revision: feat/new-status-screens

    ## KeyPeek support
    - name: zmk-raw-hid
      remote: zzeneg
      revision: main
    - name: zmk-keypeek-layer-notifier
      remote: srwi
      revision: master

  self:
    path: config
```
