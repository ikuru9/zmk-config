/ {
    chosen {
        zephyr,console = &snippet_scanner_target;
        zephyr,shell-uart = &snippet_scanner_target;
    };
};

&zephyr_udc0 {
    snippet_scanner_target: snippet_scanner_target {
        compatible = "zephyr,cdc-acm-uart";
    };
};