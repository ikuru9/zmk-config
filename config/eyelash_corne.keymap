#define CONFIG_WIRELESS  

#define ZMK_BASE_LAYER(name, LT, RT, LM, RM, LB, RB, LH, RH)                                  \
    ZMK_LAYER(                                                                                \
        name,                                                                                 \
        &kp ESC     LT                            JS0_BINDING               RT  &kp LBKT      \
        &kp TAB     LM               JS1_BINDING  JS2_BINDING  JS3_BINDING  RM  &kp RBKT      \
        &kp CAPS    LB  LEC_BINDING(&kp C_MUTE)   JS4_BINDING               RB  &kp BSLH      \
        &kp LALT    LH                                                      RH  &kp DEL,      \
        SENSOR_VOLUME_BINDING                                                                 \
    )

#include "continuum/utils/encoders.h"
#include "continuum/matrix/eyelash_corne42.h"
#include "continuum/base.keymap"
