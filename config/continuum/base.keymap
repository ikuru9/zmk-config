#include <behaviors.dtsi>
#include <dt-bindings/zmk/keys.h>

#include <behaviors/num_word.dtsi> // Requires zmk-auto-layer module.

#include "utils/helper.h"
#include "macro.dtsi"


#ifdef CONFIG_WIRELESS
  #include <dt-bindings/zmk/bt.h>
  #include <dt-bindings/zmk/outputs.h>
  #define _BT_SEL_KEYS_                                                        \
      &bt BT_SEL 0 &bt BT_SEL 1 &bt BT_SEL 2 &bt BT_SEL 3 &bt BT_CLR
  #define _BT_DIS_KEYS_                                                        \
      &bt BT_DISC 0 &bt BT_DISC 1 &bt BT_DISC 2 &bt BT_DISC 3 &bt BT_CLR_ALL
  #define _BT_NAV_KEYS_ &bt BT_PRV &bt BT_NXT &bt BT_CLR
  #define _OUT_KEYS_    &out OUT_TOG &out OUT_USB &out OUT_BLE
#else
  #define _BT_SEL_KEYS_ &trans &trans &trans &trans &trans
  #define _BT_DIS_KEYS_ &trans &trans &trans &trans &trans
  #define _BT_NAV_KEYS_ &trans &trans &trans
  #define _OUT_KEYS_    &trans &trans &trans
#endif

#define DEF 0
#define NUM 1
#define NAV 2
#define FN 3
#define SYS 4
#define MOUSE 5

#define XXX &none
#define ___ &trans

/* Global defaults */

#define QUICK_TAP_MS 175

&sk {
  release-after-ms = <900>;
  quick-release;
};

&sl { // Allow sticky mods to chord across sticky layers.
  ignore-modifiers;
};

&lt {
  flavor = "balanced";
  tapping-term-ms = <200>;
  quick-tap-ms = <QUICK_TAP_MS>;
};

/* Homerow mods */

#define KEYS_L LT0 LT1 LT2 LT3 LT4 LM0 LM1 LM2 LM3 LM4 LB0 LB1 LB2 LB3 LB4
#define KEYS_R RT0 RT1 RT2 RT3 RT4 RM0 RM1 RM2 RM3 RM4 RB0 RB1 RB2 RB3 RB4
#ifndef LH2
  #define THUMBS LH1 LH0 RH0 RH1         // Thumbs on 34 keys.
#else
  #define THUMBS LH2 LH1 LH0 RH0 RH1 RH2 // Thumbs on 36+ keys.
#endif

#define MAKE_HRM(NAME, HOLD, TAP, TRIGGER_POS)                                 \
  ZMK_HOLD_TAP(NAME, bindings = <HOLD>, <TAP>; flavor = "balanced";            \
               tapping-term-ms = <280>; quick-tap-ms = <QUICK_TAP_MS>;         \
               require-prior-idle-ms = <150>; hold-trigger-on-release;         \
               hold-trigger-key-positions = <TRIGGER_POS>;)

MAKE_HRM(hml, &kp, &kp, KEYS_R THUMBS) // Left-hand HRMs.
MAKE_HRM(hmr, &kp, &kp, KEYS_L THUMBS) // Right-hand HRMs.

// Hack: Make HRM combos tap-only (cf, ZMK issue #544).
#define ZMK_COMBO_8(NAME, TAP, POS, LAYERS, COMBO_MS, IDLE_MS, HOLD, SIDE)     \
  MAKE_HRM(hm_combo_##NAME, &kp, TAP, SIDE THUMBS)                             \
  ZMK_COMBO_6(NAME, &hm_combo_##NAME HOLD 0, POS, LAYERS, COMBO_MS, IDLE_MS)


/* Nav cluster */

// Trigger tap-action on all interrupts.
#define MT_CORE                                                                \
  flavor = "tap-preferred";                                                    \
  tapping-term-ms = <220>;                                                     \
  quick-tap-ms = <220>;                                                        \
  hold-trigger-key-positions = <0>;

&mt { MT_CORE };

#define MASK_MODS(NAME, MODS, BINDING)                                         \
  ZMK_MOD_MORPH(NAME, bindings = <BINDING>, <BINDING>; mods = <MODS>;)

/* Combos and mouse emulation */
#include "shortcuts.dtsi"
#include "macro.dtsi"
#include "combos.dtsi" // Must be sourced after HRM-combo hack.
#include "mouse.dtsi"

/* Magic-shift & auto-layers */
// Tap: repeat after alpha, else sticky-shift |
// Shift + tap/ double-tap: caps-word | Hold: shift.
#define MAGIC_SHIFT &magic_shift LSHFT 0
ZMK_HOLD_TAP(magic_shift, bindings = <&kp>, <&magic_shift_tap>;
             flavor = "balanced"; tapping-term-ms = <200>;
             quick-tap-ms = <QUICK_TAP_MS>;)
ZMK_MOD_MORPH(magic_shift_tap, bindings = <&shift_repeat>, <&caps_word>;
              mods = <(MOD_LSFT)>;)
ZMK_ADAPTIVE_KEY(
    shift_repeat, bindings = <&sk LSHFT>;
    repeat {
      trigger-keys = <A B C D E F G H I J K L M N O P Q R S T U V W X Y Z>;
      bindings = <&key_repeat>;
      max-prior-idle-ms = <1200>;
      strict-modifiers;
    };)
&caps_word { // Mods deactivate caps-word, requires PR #1451. [TODO: rebase]
  /delete-property/ ignore-modifiers;
};

// Tap: num-word | double-tap: sticky num-layer | Hold: num-layer.
#define SMART_NUM &smart_num NUM 0
ZMK_HOLD_TAP(smart_num, bindings = <&mo>, <&num_dance>; flavor = "balanced";
             tapping-term-ms = <200>; quick-tap-ms = <QUICK_TAP_MS>;)
ZMK_TAP_DANCE(num_dance, bindings = <&num_word NUM>, <&sl NUM>;
              tapping-term-ms = <200>;)

// Smart-mouse, requires tri-state module.
ZMK_TRI_STATE(
    smart_mouse, bindings = <&tog MOUSE>, <&none>, <&tog MOUSE>;
    ignored-key-positions =
        <LT1 LT2 LH0 LH1 RT1 RT2 RT3 RM0 RM1 RM2 RM3 RM4 RB1 RB2 RB3 RH0 RH1>;
    ignored-layers = <MOUSE NAV FN>;)

/* Custom behaviors */

// Alt+Tab swapper, requires tri-state module.
ZMK_TRI_STATE(swapper, bindings = <&kt LALT>, <&kp TAB>, <&kt LALT>;
              ignored-key-positions = <LT2 RT2 RM1 RM2 RM3>;)

// Define mod-morph with a *single* mod trigger for less repetition.
#define SIMPLE_MORPH(NAME, MOD, BINDING1, BINDING2)                            \
  ZMK_MOD_MORPH(NAME, mods = <(MOD_L##MOD | MOD_R##MOD)>;                      \
                bindings = <BINDING1>, <BINDING2>;)

// Tap: comma | Shift + tap: semicolon | Ctrl + shift + tap: <.
SIMPLE_MORPH(comma_morph, SFT, &kp COMMA, &comma_inner_morph)
SIMPLE_MORPH(comma_inner_morph, CTL, &kp SEMICOLON, &kp LESS_THAN)

// Tap: dot | Shift + tap: colon | Ctrl + shift + tap: >.
SIMPLE_MORPH(dot_morph, SFT, &kp DOT, &dot_inner_morph)
SIMPLE_MORPH(dot_inner_morph, CTL, &kp COLON, &kp GREATER_THAN)

// Tap: qmark | Shift + tap: excl.
SIMPLE_MORPH(qexcl, SFT, &kp QMARK, &kp EXCL)

// Tap: sqt | Shift + tap: dqt.
SIMPLE_MORPH(sqt_morph, SFT, &kp SQT, &kp DQT)

// Tap: left/right parenthesis | Shft + tap: less-than/greater-than.
SIMPLE_MORPH(lpar_lt, SFT, &kp LPAR, &kp LT)
SIMPLE_MORPH(rpar_gt, SFT, &kp RPAR, &kp GT)

// Tap: { / } | Shift + tap: [ / ].
SIMPLE_MORPH(lbrc_morph, SFT, &kp LBRC, &kp LBKT)
SIMPLE_MORPH(rbrc_morph, SFT, &kp RBRC, &kp RBKT)

// Tap: space | Shift + tap: dot -> space -> sticky shift | Hold: nav layer.
ZMK_HOLD_TAP(lt_spc, bindings = <&mo>, <&spc_morph>; flavor = "balanced";
             tapping-term-ms = <200>; quick-tap-ms = <QUICK_TAP_MS>;)
SIMPLE_MORPH(spc_morph, SFT, &kp SPACE, &dot_spc)
ZMK_MACRO(dot_spc, bindings = <&kp DOT &kp SPACE &sk LSHFT>; wait-ms = <0>;
          tap-ms = <5>;)

// Tap: backspace | Lshft + tap: delete | Rshft + tap: shift-delete.
ZMK_MOD_MORPH(bs_del, bindings = <&kp BSPC>, <&kp DEL>;
              mods = <(MOD_LSFT|MOD_RSFT)>; keep-mods = <MOD_RSFT>;)

// Tap: lang change | double-tap: screenshot.
ZMK_TAP_DANCE(lang_screen, bindings = <&kp LANG_CHANGE>, <&kp SCREENSHOT>;
              tapping-term-ms = <200>;)
// Tap: undo | double-tap: redo.
ZMK_TAP_DANCE(undo_redo, bindings = <&kp C_UND>, <&kp C_RDO>;
              tapping-term-ms = <200>;)

#define CANCEL    &kp K_CANCEL            // Cancel caps-word & auto-layers.

/* Keymap */

// NAV + NUM = SYS
ZMK_CONDITIONAL_LAYER(sys, NAV NUM, SYS)

#ifndef ZMK_BASE_LAYER
  #define ZMK_BASE_LAYER(name, LT, RT, LM, RM, LB, RB, LH, RH)                 \
      ZMK_LAYER(name, LT RT LM RM LB RB LH RH)
#endif

ZMK_BASE_LAYER(Base,                                                                                                                                                                                   \
// ╭─────────────────┬─────────────────┬─────────────────┬─────────────────┬─────────────────╮   ╭─────────────────┬─────────────────┬─────────────────┬─────────────────┬─────────────────╮
     &kp Q             &kp W             &kp E             &kp R             &kp T           ,     &kp Y             &kp U             &kp I             &kp O             &kp P           ,           \
// ├─────────────────┼─────────────────┼─────────────────┼─────────────────┼─────────────────┤   ├─────────────────┼─────────────────┼─────────────────┼─────────────────┼─────────────────┤
     &hml OL_PNK A     &hml LALT S       &hml LSHFT D      &hml OL_IDX F     &kp G           ,     &kp H             &hmr OL_IDX J     &hmr LSHFT K      &hmr LALT L       &hmr OL_PNK SQT ,           \
// ├─────────────────┼─────────────────┼─────────────────┼─────────────────┼─────────────────┤   ├─────────────────┼─────────────────┼─────────────────┼─────────────────┼─────────────────┤
     &kp Z             &kp X             &kp C             &kp V             &kp B           ,     &kp N             &kp M             &hmr SEMI COMMA   &hmr COLON DOT    &hmr EXCL QMARK ,           \
// ╰─────────────────┼─────────────────┴─────────────────┼─────────────────┼─────────────────┤   ├─────────────────┼─────────────────┼─────────────────┴─────────────────┴─────────────────╯
                                                           &lt FN TAB        &lt NAV SPACE   ,     &lt NUM RET       &bs_del                                                                           \
//                                                       ╰─────────────────┴─────────────────╯   ╰─────────────────┴─────────────────╯
)

ZMK_BASE_LAYER(Num,                                                                                                                                                                                    \
// ╭─────────────────┬─────────────────┬─────────────────┬─────────────────┬─────────────────╮   ╭─────────────────┬─────────────────┬─────────────────┬─────────────────┬─────────────────╮
     XXX               &hml LS(N7) N7    &hml LS(N8) N8    &hml LS(N9) N9    XXX             ,     &kp PLUS          &kp RBRC          &kp RPAR          &kp RBKT          &kp GT          ,           \
// ├─────────────────┼─────────────────┼─────────────────┼─────────────────┼─────────────────┤   ├─────────────────┼─────────────────┼─────────────────┼─────────────────┼─────────────────┤
     XXX               &hml LS(N4) N4    &hml LS(N5) N5    &hml LS(N6) N6    XXX             ,     &kp MINUS         &CT_BRACES        &CT_PARENS        &CT_BRACKETS      &CT_ANGLE       ,           \
// ├─────────────────┼─────────────────┼─────────────────┼─────────────────┼─────────────────┤   ├─────────────────┼─────────────────┼─────────────────┼─────────────────┼─────────────────┤
     XXX               &hml LS(N1) N1    &hml LS(N2) N2    &hml LS(N3) N3    XXX             ,     &kp EQUAL         XXX               XXX               XXX               XXX             ,           \
// ╰─────────────────┼─────────────────┴─────────────────┼─────────────────┼─────────────────┤   ├─────────────────┼─────────────────┼─────────────────┴─────────────────┴─────────────────╯
                                                           &hml LS(N0) N0    ___             ,     ___               CANCEL                                                                            \
//                                                       ╰─────────────────┴─────────────────╯   ╰─────────────────┴─────────────────╯
)

ZMK_BASE_LAYER(Nav,                                                                                                                                                                                    \
// ╭─────────────────┬─────────────────┬─────────────────┬─────────────────┬─────────────────╮   ╭─────────────────┬─────────────────┬─────────────────┬─────────────────┬─────────────────╮
     XXX               SP_LEFT           SP_RIGHT          FIT_LEFT          FIT_RIGHT       ,     XXX               XXX               NAV_UP            XXX               XXX             ,           \
// ├─────────────────┼─────────────────┼─────────────────┼─────────────────┼─────────────────┤   ├─────────────────┼─────────────────┼─────────────────┼─────────────────┼─────────────────┤
     &kp OL_PNK        &kp LALT          &kp LSHFT         &kp OL_IDX        SPACE_FULL      ,     XXX               NAV_LEFT          NAV_DOWN          NAV_RIGHT         XXX             ,           \
// ├─────────────────┼─────────────────┼─────────────────┼─────────────────┼─────────────────┤   ├─────────────────┼─────────────────┼─────────────────┼─────────────────┼─────────────────┤
     XXX               WIN_LEFT          XXX               WIN_RIGHT         XXX             ,     XXX               XXX               XXX               XXX               XXX             ,           \
// ╰─────────────────┼─────────────────┴─────────────────┼─────────────────┼─────────────────┤   ├─────────────────┼─────────────────┼─────────────────┴─────────────────┴─────────────────╯
                                                           ___               ___             ,     ___               CANCEL                                                                            \
//                                                       ╰─────────────────┴─────────────────╯   ╰─────────────────┴─────────────────╯
)

ZMK_BASE_LAYER(Fn,                                                                                                                                                                                     \
// ╭─────────────────┬─────────────────┬─────────────────┬─────────────────┬─────────────────╮   ╭─────────────────┬─────────────────┬─────────────────┬─────────────────┬─────────────────╮
     XXX               &kp F7            &kp F8            &kp F9            &kp F12         ,     &kp C_VOL_UP      XXX               XXX               &CT_PASS01        &CT_PASS02      ,           \
// ├─────────────────┼─────────────────┼─────────────────┼─────────────────┼─────────────────┤   ├─────────────────┼─────────────────┼─────────────────┼─────────────────┼─────────────────┤
     XXX               &kp F4            &kp F5            &kp F6            &kp F11         ,     &kp C_VOL_DN      &kp C_PREV        &kp C_PP          &kp C_NEXT        XXX             ,           \
// ├─────────────────┼─────────────────┼─────────────────┼─────────────────┼─────────────────┤   ├─────────────────┼─────────────────┼─────────────────┼─────────────────┼─────────────────┤
     XXX               &kp F1            &kp F2            &kp F3            &kp F10         ,     &kp C_MUTE        XXX               XXX               XXX               XXX             ,           \
// ╰─────────────────┼─────────────────┴─────────────────┼─────────────────┼─────────────────┤   ├─────────────────┼─────────────────┼─────────────────┴─────────────────┴─────────────────╯
                                                           ___               ___             ,     LOCK              CANCEL                                                                            \
//                                                       ╰─────────────────┴─────────────────╯   ╰─────────────────┴─────────────────╯
)

ZMK_BASE_LAYER(Sys,                                                                                                                                                                                    \
// ╭─────────────────┬─────────────────┬─────────────────┬─────────────────┬─────────────────╮   ╭─────────────────┬─────────────────┬─────────────────┬─────────────────┬─────────────────╮
                                         _BT_SEL_KEYS_                                       ,     XXX               XXX                                 _OUT_KEYS_                        ,           \
// ├─────────────────┼─────────────────┼─────────────────┼─────────────────┼─────────────────┤   ├─────────────────┼─────────────────┼─────────────────┼─────────────────┼─────────────────┤
     XXX               XXX               XXX               XXX               XXX             ,     XXX               XXX               XXX               XXX               XXX             ,           \
// ├─────────────────┼─────────────────┼─────────────────┼─────────────────┼─────────────────┤   ├─────────────────┼─────────────────┼─────────────────┼─────────────────┼─────────────────┤
     &bootloader       &sys_reset        XXX               XXX               XXX             ,     XXX               XXX               XXX               &sys_reset        &bootloader     ,           \
// ╰─────────────────┼─────────────────┴─────────────────┼─────────────────┼─────────────────┤   ├─────────────────┼─────────────────┼─────────────────┴─────────────────┴─────────────────╯
                                                           ___               ___             ,     ___               CANCEL                                                                            \
//                                                       ╰─────────────────┴─────────────────╯   ╰─────────────────┴─────────────────╯
)

ZMK_BASE_LAYER(Mouse,                                                                                                                                                                                  \
// ╭─────────────────┬─────────────────┬─────────────────┬─────────────────┬─────────────────╮   ╭─────────────────┬─────────────────┬─────────────────┬─────────────────┬─────────────────╮
     XXX               XXX               XXX               XXX               XXX             ,     MS_WH_U           &mkp LCLK         MS_MV_U           &mkp RCLK         MS_WH_L         ,           \
// ├─────────────────┼─────────────────┼─────────────────┼─────────────────┼─────────────────┤   ├─────────────────┼─────────────────┼─────────────────┼─────────────────┼─────────────────┤
     XXX               XXX               XXX               XXX               XXX             ,     MS_WH_D           MS_MV_L           MS_MV_D           MS_MV_R           MS_WH_R         ,           \
// ├─────────────────┼─────────────────┼─────────────────┼─────────────────┼─────────────────┤   ├─────────────────┼─────────────────┼─────────────────┼─────────────────┼─────────────────┤
     XXX               XXX               XXX               XXX               XXX             ,     XXX               XXX               XXX               XXX               XXX             ,           \
// ╰─────────────────┼─────────────────┴─────────────────┼─────────────────┼─────────────────┤   ├─────────────────┼─────────────────┼─────────────────┴─────────────────┴─────────────────╯
                                                           XXX               XXX             ,     ___               CANCEL                                                                            \
//                                                       ╰─────────────────┴─────────────────╯   ╰─────────────────┴─────────────────╯
)
